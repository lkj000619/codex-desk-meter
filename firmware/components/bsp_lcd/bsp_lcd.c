#include "bsp_lcd.h"

#include <stdio.h>
#include <string.h>

#include "driver/gpio.h"
#include "driver/ledc.h"
#include "esp_check.h"
#include "esp_heap_caps.h"
#include "esp_lcd_panel_ops.h"
#include "esp_lcd_panel_rgb.h"
#include "esp_log.h"
#include "esp_rom_sys.h"
#include "freertos/FreeRTOS.h"
#include "freertos/task.h"

static const char *TAG = "bsp_lcd";

#define PIN_CS 0
#define PIN_SCK 2
#define PIN_SDA 1
#define PIN_RESET 16
#define PIN_BL 6

#define PIN_DE 40
#define PIN_PCLK 41
#define PIN_VSYNC 39
#define PIN_HSYNC 38

static const int s_data_pins[16] = {
    21, 5, 45, 48, 47, /* B0..B4 */
    14, 13, 12, 11, 10, 9, /* G0..G5 */
    17, 46, 3, 8, 18 /* R0..R4 */
};

static esp_lcd_panel_handle_t s_panel;
static uint16_t *s_logic;  /* 820x320 logical canvas in PSRAM */
static uint16_t *s_stage;  /* 320x820 portrait staging in PSRAM */

/* ---- 5x7 font (public-domain style classic), ASCII 32..127 ---- */
static const uint8_t s_font[96][7] = {
    {0x00,0x00,0x00,0x00,0x00,0x00,0x00},{0x04,0x04,0x04,0x04,0x04,0x00,0x04},
    {0x0A,0x0A,0x0A,0x00,0x00,0x00,0x00},{0x0A,0x0A,0x1F,0x0A,0x1F,0x0A,0x0A},
    {0x04,0x0F,0x14,0x0E,0x05,0x1E,0x04},{0x18,0x19,0x02,0x04,0x08,0x13,0x03},
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    {0x00,0x00,0x0A,0x15,0x00,0x00,0x00},
};

uint16_t bsp_rgb565(uint8_t r, uint8_t g, uint8_t b) {
    return (uint16_t)(((r & 0xF8) << 8) | ((g & 0xFC) << 3) | (b >> 3));
}

static void spi_delay(void) {
    esp_rom_delay_us(1);
}

static void spi_write_byte_9bit(int dc, uint8_t data) {
    /* ST7701 3-wire 9-bit: EVERY byte carries a DC phase bit first (MSB),
     * then 8 data bits MSB-first, mode 0. */
    gpio_set_level(PIN_SDA, dc);
    gpio_set_level(PIN_SCK, 0);
    spi_delay();
    gpio_set_level(PIN_SCK, 1);
    spi_delay();
    for (int i = 7; i >= 0; i--) {
        gpio_set_level(PIN_SDA, (data >> i) & 1);
        gpio_set_level(PIN_SCK, 0);
        spi_delay();
        gpio_set_level(PIN_SCK, 1);
        spi_delay();
    }
}

static void lcd_cmd(uint8_t cmd) {
    gpio_set_level(PIN_CS, 0);
    spi_write_byte_9bit(0, cmd);
    gpio_set_level(PIN_CS, 1);
    spi_delay();
}

static void lcd_data(const uint8_t *data, size_t n) {
    if (n == 0) {
        return;
    }
    gpio_set_level(PIN_CS, 0);
    for (size_t i = 0; i < n; i++) {
        spi_write_byte_9bit(1, data[i]);
    }
    gpio_set_level(PIN_CS, 1);
    spi_delay();
}

typedef struct {
    uint8_t cmd;
    uint8_t data[16];
    uint8_t len;
    uint16_t delay_ms;
} init_cmd_t;

/* ST7701 init bytes for this 320x820 panel (board settings observed in the
 * vendor FactoryProgram main.cpp). Stored in our own table layout. */
static const init_cmd_t s_init[] = {
    {0xFF, {0x77, 0x01, 0x00, 0x00, 0x13}, 5, 0},
    {0xEF, {0x08}, 1, 0},
    {0xFF, {0x77, 0x01, 0x00, 0x00, 0x10}, 5, 0},
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    {0x29, {0}, 0, 20},
};

esp_err_t bsp_backlight_set_brightness(uint8_t brightness_0_255) {
    uint16_t duty = (uint16_t)(255u - brightness_0_255); /* active-low */
    ESP_RETURN_ON_ERROR(ledc_set_duty(LEDC_LOW_SPEED_MODE, LEDC_CHANNEL_1, duty), TAG, "duty");
    ESP_RETURN_ON_ERROR(ledc_update_duty(LEDC_LOW_SPEED_MODE, LEDC_CHANNEL_1), TAG, "update");
    return ESP_OK;
}

static esp_err_t backlight_init(void) {
    gpio_config_t gc = {
        .pin_bit_mask = (1ULL << PIN_BL),
        .mode = GPIO_MODE_OUTPUT,
        .pull_up_en = GPIO_PULLUP_ENABLE,
        .pull_down_en = GPIO_PULLDOWN_DISABLE,
        .intr_type = GPIO_INTR_DISABLE,
    };
    ESP_RETURN_ON_ERROR(gpio_config(&gc), TAG, "bl gpio");
    ledc_timer_config_t tc = {
        .speed_mode = LEDC_LOW_SPEED_MODE,
        .duty_resolution = LEDC_TIMER_8_BIT,
        .timer_num = LEDC_TIMER_3,
        .freq_hz = 50 * 1000,
        .clk_cfg = LEDC_SLOW_CLK_RC_FAST,
    };
    ESP_RETURN_ON_ERROR(ledc_timer_config(&tc), TAG, "bl timer");
    ledc_channel_config_t cc = {
        .gpio_num = PIN_BL,
        .speed_mode = LEDC_LOW_SPEED_MODE,
        .channel = LEDC_CHANNEL_1,
        .intr_type = LEDC_INTR_DISABLE,
        .timer_sel = LEDC_TIMER_3,
        .duty = (uint32_t)(255u - 200u),
        .hpoint = 0,
    };
    ESP_RETURN_ON_ERROR(ledc_channel_config(&cc), TAG, "bl ch");
    return ESP_OK;
}

esp_err_t bsp_lcd_init(void) {
    gpio_config_t gc = {
        .pin_bit_mask = (1ULL << PIN_CS) | (1ULL << PIN_SCK) | (1ULL << PIN_SDA) | (1ULL << PIN_RESET),
        .mode = GPIO_MODE_OUTPUT,
        .pull_up_en = GPIO_PULLUP_DISABLE,
        .pull_down_en = GPIO_PULLDOWN_DISABLE,
        .intr_type = GPIO_INTR_DISABLE,
    };
    ESP_RETURN_ON_ERROR(gpio_config(&gc), TAG, "gpio");
    ESP_RETURN_ON_ERROR(backlight_init(), TAG, "backlight");

    gpio_set_level(PIN_CS, 1);
    gpio_set_level(PIN_SCK, 0);
    gpio_set_level(PIN_SDA, 0);
    gpio_set_level(PIN_RESET, 1);
    vTaskDelay(pdMS_TO_TICKS(10));
    gpio_set_level(PIN_RESET, 0);
    vTaskDelay(pdMS_TO_TICKS(20));
    gpio_set_level(PIN_RESET, 1);
    vTaskDelay(pdMS_TO_TICKS(120));

    for (size_t i = 0; i < sizeof(s_init) / sizeof(s_init[0]); i++) {
        lcd_cmd(s_init[i].cmd);
        lcd_data(s_init[i].data, s_init[i].len);
        if (s_init[i].delay_ms) {
            vTaskDelay(pdMS_TO_TICKS(s_init[i].delay_ms));
        }
    }

    esp_lcd_rgb_panel_config_t rgb = {0};
    rgb.clk_src = LCD_CLK_SRC_DEFAULT;
    rgb.timings.pclk_hz = 18 * 1000 * 1000;
    rgb.timings.h_res = BSP_LCD_PHYS_W;
    rgb.timings.v_res = BSP_LCD_PHYS_H;
    rgb.timings.hsync_pulse_width = 6;
    rgb.timings.hsync_back_porch = 30;
    rgb.timings.hsync_front_porch = 30;
    rgb.timings.vsync_pulse_width = 40;
    rgb.timings.vsync_back_porch = 20;
    rgb.timings.vsync_front_porch = 20;
    rgb.data_width = 16;
    rgb.bits_per_pixel = 16;
    rgb.num_fbs = 2;
    rgb.bounce_buffer_size_px = 10 * BSP_LCD_PHYS_W;
    rgb.psram_trans_align = 64;
    rgb.hsync_gpio_num = PIN_HSYNC;
    rgb.vsync_gpio_num = PIN_VSYNC;
    rgb.de_gpio_num = PIN_DE;
    rgb.pclk_gpio_num = PIN_PCLK;
    rgb.disp_gpio_num = -1;
    for (int i = 0; i < 16; i++) {
        rgb.data_gpio_nums[i] = s_data_pins[i];
    }
    rgb.flags.fb_in_psram = 1;

    ESP_RETURN_ON_ERROR(esp_lcd_new_rgb_panel(&rgb, &s_panel), TAG, "rgb panel");
    ESP_RETURN_ON_ERROR(esp_lcd_panel_reset(s_panel), TAG, "reset");
    ESP_RETURN_ON_ERROR(esp_lcd_panel_init(s_panel), TAG, "init");

    s_logic = heap_caps_malloc(BSP_LCD_LOGIC_W * BSP_LCD_LOGIC_H * 2, MALLOC_CAP_SPIRAM);
    s_stage = heap_caps_malloc(BSP_LCD_PHYS_W * BSP_LCD_PHYS_H * 2, MALLOC_CAP_SPIRAM);
    if (!s_logic || !s_stage) {
        ESP_LOGE(TAG, "PSRAM framebuffer allocation failed");
        return ESP_ERR_NO_MEM;
    }
    bsp_lcd_fill(bsp_rgb565(4, 8, 16));
    ESP_RETURN_ON_ERROR(bsp_lcd_flush(), TAG, "flush");
    ESP_LOGI(TAG, "LCD ready: portrait timings %dx%d, logical %dx%d",
             BSP_LCD_PHYS_W, BSP_LCD_PHYS_H, BSP_LCD_LOGIC_W, BSP_LCD_LOGIC_H);
    return ESP_OK;
}

void bsp_lcd_fill(uint16_t rgb565) {
    if (!s_logic) {
        return;
    }
    size_t n = BSP_LCD_LOGIC_W * BSP_LCD_LOGIC_H;
    for (size_t i = 0; i < n; i++) {
        s_logic[i] = rgb565;
    }
}

static void draw_glyph(int lx, int ly, char c, uint16_t fg, uint16_t bg) {
    if (!s_logic || lx < 0 || ly < 0) {
        return;
    }
    unsigned idx = (c >= 32 && c < 127) ? (unsigned)(c - 32) : 0;
    /* 2x scale: cell 12x16 incl. spacing. */
    for (int row = 0; row < 7; row++) {
        uint8_t bits = s_font[idx][row];
        for (int col = 0; col < 5; col++) {
            int on = (bits >> (4 - col)) & 1;
            uint16_t color = on ? fg : bg;
            for (int dy = 0; dy < 2; dy++) {
                for (int dx = 0; dx < 2; dx++) {
                    int x = lx + col * 2 + dx;
                    int y = ly + row * 2 + dy;
                    if (x < BSP_LCD_LOGIC_W && y < BSP_LCD_LOGIC_H) {
                        s_logic[y * BSP_LCD_LOGIC_W + x] = color;
                    }
                }
            }
        }
    }
}

static void draw_text(int lx, int ly, const char *s, uint16_t fg, uint16_t bg) {
    int x = lx;
    for (const char *p = s; *p && x + 12 <= BSP_LCD_LOGIC_W; p++, x += 12) {
        draw_glyph(x, ly, *p, fg, bg);
    }
}

void bsp_lcd_show_text(const char lines[][65], int n_lines, const char *header) {
    uint16_t bg = bsp_rgb565(4, 8, 16);
    uint16_t fg = bsp_rgb565(235, 245, 255);
    uint16_t acc = bsp_rgb565(140, 220, 255);
    bsp_lcd_fill(bg);
    if (header) {
        char h[65];
        snprintf(h, sizeof h, "%s", header);
        draw_text(12, 8, h, acc, bg);
    }
    for (int i = 0; i < n_lines && i < 12; i++) {
        draw_text(12, 36 + i * 22, lines[i], fg, bg);
    }
}

esp_err_t bsp_lcd_flush(void) {
    if (!s_panel || !s_logic || !s_stage) {
        return ESP_ERR_INVALID_STATE;
    }
    /* 90-degree transpose: logical (lx,ly) -> portrait (ly, PHYS_H-1-lx). */
    for (int ly = 0; ly < BSP_LCD_LOGIC_H; ly++) {
        for (int lx = 0; lx < BSP_LCD_LOGIC_W; lx++) {
            int px = ly;
            int py = (BSP_LCD_PHYS_H - 1) - lx;
            s_stage[py * BSP_LCD_PHYS_W + px] = s_logic[ly * BSP_LCD_LOGIC_W + lx];
        }
    }
    return esp_lcd_panel_draw_bitmap(s_panel, 0, 0, BSP_LCD_PHYS_W, BSP_LCD_PHYS_H, s_stage);
}
